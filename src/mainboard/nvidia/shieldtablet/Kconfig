## src/mainboard/nvidia/shieldtablet/Kconfig
```kconfig
## SPDX-License-Identifier: GPL-2.0-only

if BOARD_NVIDIA_SHIELDTABLET

config BOARD_SPECIFIC_OPTIONS
	def_bool y
	select SOC_NVIDIA_TEGRA124
	select COMMON_CBFS_SPI_WRAPPER
	select TEGRA124_MODEL_CD570M
	select BOARD_ROMSIZE_KB_4096
	select SPI_FLASH
	select SPI_FLASH_GIGADEVICE
	select SPI_FLASH_WINBOND
	select DRIVERS_AS3722_RTC

config VBOOT
	select EC_GOOGLE_CHROMEEC_SWITCHES
	select VBOOT_VBNV_FLASH

config MAINBOARD_DIR
	default "nvidia/shieldtablet"

config MAINBOARD_PART_NUMBER
	default "tn8"

choice
	prompt "BCT boot media"
	default TN8_BCT_CFG_SPI
	help
	  Which boot media to configure the BCT for.

config TN8_BCT_CFG_SPI
	bool "SPI"
	help
	  Configure the BCT for booting from SPI.

config TN8_BCT_CFG_EMMC
	bool "eMMC"
	help
	  Configure the BCT for booting from eMMC.

endchoice

config BOOT_DEVICE_SPI_FLASH_BUS
	int "SPI bus with boot media ROM"
	range 1 6
	depends on TN8_BCT_CFG_SPI
	default 4
	help
	  Which SPI bus the boot media is connected to.

config DRIVER_TPM_I2C_BUS
	hex
	default 0x2

config DRIVER_TPM_I2C_ADDR
	hex
	default 0x20

config DRIVERS_AS3722_RTC_BUS
	int
	default 4

config DRIVERS_AS3722_RTC_ADDR
	hex
	default 0x40

endif # BOARD_GOOGLE_NYAN
```

## src/mainboard/nvidia/shieldtablet/Kconfig.name
```kconfig
comment "Shieldtablet"

config BOARD_NVIDIA_SHIELDTABLET
	bool "->  shieldtablet"
```
